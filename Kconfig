## Kconfig
```kconfig
# SPDX-License-Identifier: MIT

config ZMK_BEHAVIOR_BATTERY_LED
    bool "Battery LED behavior"
    default y
    depends on ZMK
```

## dts/bindings/behaviors/zmk,behavior-battery-led.yaml
```yaml
# SPDX-License-Identifier: MIT

description: Battery LED Behavior
compatible: "zmk,behavior-battery-led"
include: zero_param.yaml
```
